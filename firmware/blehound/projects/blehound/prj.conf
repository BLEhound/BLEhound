## CMakeLists.txt
```
# SPDX-License-Identifier: Apache-2.0
#
# BLEhound Sniffer firmware top-level CMake
# Note: this is a Zephyr / nRF Connect SDK "freestanding" application.
#   - The build depends on an external NCS (provided via west); this repo does not contain the SDK itself.
#   - For local builds see tools/build.sh; for open-source reproduction see west.yml + README in the repo root.

cmake_minimum_required(VERSION 3.20.0)

find_package(Zephyr REQUIRED HINTS $ENV{ZEPHYR_BASE})
project(nrf_ble_sniffer LANGUAGES C)

target_sources(app PRIVATE
    src/main.c
    src/cobs.c
    src/host_iface.c
    src/ble_csa.c
    src/ble_ctrl_pdu.c
    src/conn_follower.c
    src/board_role.c
    src/peer_msg.c
    src/peer_txq.c
    src/sync_line.c
    src/peer_link.c
    src/tri_coord.c
    src/fem_ctrl.c
    src/ble_aes128.c
)

# The Radio HAL implementation is selected per chip -- this is the whole point of the HAL abstraction:
# the upper layers (CSA / connection following / host protocol) stay completely unchanged, and switching
# chips only swaps this one file. To add a new chip, just add another branch here.
if(CONFIG_SOC_SERIES_NRF54L)
    target_sources(app PRIVATE src/radio_nrf54l.c)
else()
    target_sources(app PRIVATE src/radio_nrf52.c)   # nRF52 series (default)
endif()

target_include_directories(app PRIVATE
    src
    ${CMAKE_CURRENT_BINARY_DIR}/blehound_generated
)

# Firmware version: V<MAJOR>.<MINOR>.<PATCH>.<BUILD>, BUILD = git commit count of this repo,
# incremented with every commit. The generator runs on every build so a rebuild after a commit
# picks it up; outside a git repo (e.g. an exported source archive) it falls back to 0.
# The version in the MCUboot image header is generated by sysbuild.cmake with the same rule.
set(BLEHOUND_VERSION_BASE "V1.0.0")
add_custom_target(blehound_version
    BYPRODUCTS ${CMAKE_CURRENT_BINARY_DIR}/blehound_generated/blehound_version.h
    COMMAND ${CMAKE_COMMAND}
        -DBASE=${BLEHOUND_VERSION_BASE}
        -DSRC_DIR=${CMAKE_CURRENT_SOURCE_DIR}
        -DOUT=${CMAKE_CURRENT_BINARY_DIR}/blehound_generated/blehound_version.h
        -P ${CMAKE_CURRENT_SOURCE_DIR}/cmake/gen_version.cmake
    COMMENT "Generating firmware version (V1.0.0.<git commit count>)"
    VERBATIM
)
add_dependencies(app blehound_version)

# nRF54L USB uses the new UDC/usbd stack, reusing Zephyr's official USB init helper
# (sample_usbd_init.c). common.cmake only adds that source file when CONFIG_USB_DEVICE_STACK_NEXT
# is set, so it is a no-op for nRF52 (legacy stack) builds.
include(${ZEPHYR_BASE}/samples/subsys/usb/common/common.cmake)
```

## sysbuild.conf
```
# DFU: MCUboot "firmware loader" single-slot mode (partition table in boards/common/blehound_partitions.dtsi).
#  - MCUboot only verifies the signature and jumps, no dual-slot swap;
#  - the firmware loader is Nordic's stock samples/dfu/fw_loader/usb_mcumgr (SMP over USB CDC ACM),
#    only its USB identity is changed (sysbuild/usb_mcumgr.conf);
#  - button-less entry: on HOST_CMD_ENTER_DFU the app writes the boot mode into gpregret1 and resets,
#    MCUboot sees it and boots the loader (BOOT_MODE_ENTRANCE enables retention/boot mode in all three images).
SB_CONFIG_BOOTLOADER_MCUBOOT=y
SB_CONFIG_MCUBOOT_MODE_FIRMWARE_UPDATER=y
SB_CONFIG_MCUBOOT_MODE_FIRMWARE_UPDATER_BOOT_MODE_ENTRANCE=y
SB_CONFIG_FIRMWARE_LOADER_IMAGE_USB_MCUMGR=y
# Partitions come from the board devicetree, not from Partition Manager.
SB_CONFIG_PARTITION_MANAGER=n
# Signing: ed25519 "pure" (signature over the image itself, Nordic's recommendation on nRF54L); the public
# key is compiled into MCUboot, KMU is not used (KMU needs extra key provisioning at programming time, not
# introduced for now). Key file: MCUboot's bundled development key root-ed25519.pem by default; before
# production replace it with your own key and point SB_CONFIG_BOOT_SIGNATURE_KEY_FILE at it.
SB_CONFIG_BOOT_SIGNATURE_TYPE_ED25519=y
SB_CONFIG_BOOT_SIGNATURE_TYPE_PURE=y
SB_CONFIG_MCUBOOT_SIGNATURE_USING_KMU=n
# Also produce merged_<board target>.hex (MCUboot + loader + app) for whole-chip programming over J-Link.
SB_CONFIG_MERGED_HEX_FILES=y
```

## prj.conf
```kconfig
# BLEhound Sniffer — application config (board-level settings live in boards/blehound_v*/)
# Goal: validate the full "build -> flash -> run" chain + three basics: LED, RTT logging, USB CDC ACM.
# Later stages (radio / connection following) will add config on top of this.

# --- Logging: over SEGGER RTT (via J-Link, the main dev/debug channel) ---
CONFIG_LOG=y
# 2026-09-20 switched to deferred: in immediate mode sniffer_thread writes every log
# line to RTT synchronously, so the moment J-Link attaches it slows the thread down and
# capture_q overflows, dropping frames (357 queue drops observed on real hardware).
# deferred lets a dedicated log thread dequeue, so the ISR/worker threads only copy the
# message and are no longer affected by RTT read speed.
CONFIG_LOG_MODE_DEFERRED=y
CONFIG_LOG_BUFFER_SIZE=8192
CONFIG_USE_SEGGER_RTT=y
CONFIG_LOG_BACKEND_RTT=y
CONFIG_LOG_BACKEND_UART=n
CONFIG_CONSOLE=y
CONFIG_RTT_CONSOLE=y
CONFIG_UART_CONSOLE=n

# --- GPIO: on-board LED heartbeat ---
CONFIG_GPIO=y

# --- USB CDC ACM: host (Wireshark extcap) data channel ---
# nRF54LM20 USB is a DesignWare (usbhs) controller and **the legacy usb_device_stack has no driver for
# it**; only the new UDC / usb_device_stack_next stack has the udc_dwc2 + nRF54L usbhs glue. So the old
# stack is disabled, the new one enabled, and Zephyr's official sample_usbd helper initializes the device.
CONFIG_USB_DEVICE_STACK=n
CONFIG_USB_DEVICE_STACK_NEXT=y
CONFIG_USBD_CDC_ACM_CLASS=y
# Thread stacks: the new stack's defaults overflow on this chip's enumeration path (pinned down one by
# one from the Current thread in the fault dump):
#  - the usbd message-processing thread defaults to 1KB -- handling descriptors + class callbacks during
#    host enumeration/CDC configuration blows it (Current thread: usbd, STKOF). **This is the key fix.**
#  - the udc_dwc2 driver's internal thread defaults to 512B, which is a bit small.
#  - host_iface_init creates the device/descriptors on the main thread, so leave headroom there too.
CONFIG_USBD_THREAD_STACK_SIZE=2048
CONFIG_UDC_DWC2_STACK_SIZE=2048
CONFIG_MAIN_STACK_SIZE=2048
# Device identity used by sample_usbd_init.c (Zephyr's official USB init helper).
CONFIG_SAMPLE_USBD_MANUFACTURER="BLEhound"
CONFIG_SAMPLE_USBD_PRODUCT="BLEhound Sniffer"
CONFIG_SAMPLE_USBD_VID=0x1915
CONFIG_SAMPLE_USBD_PID=0x520F
# Serial layer: CDC ACM shows up as a UART device.
CONFIG_SERIAL=y
CONFIG_UART_INTERRUPT_DRIVEN=y
CONFIG_UART_LINE_CTRL=y

# --- Inter-chip link: bit-banged master port + nrfx SPIS slave port (CONFIG_NRFX_SPIS in the board defconfig); the Zephyr SPI stack is not used ---

# --- Radio: the sniffer takes over RADIO/TIMER/PPI directly, without enabling the Zephyr BLE controller ---
# Requires an external 32MHz crystal (the internal RC is not accurate enough); use clock_control to request HFXO.
CONFIG_CLOCK_CONTROL=y

# --- Runtime diagnostics ---
CONFIG_THREAD_NAME=y
CONFIG_PRINTK=y

# The RTT up buffer defaults to only 1KB, which fills up as soon as capture logs start (when full it
# drops new data, not overwrites old); enlarge it to 4KB to reduce the "I can't see any logs" confusion.
CONFIG_SEGGER_RTT_BUFFER_SIZE_UP=4096
```

## app.overlay
```dts
/*
 * Application devicetree overlay, applied on every board (there are no per-board app overlays).
 * Attaches a CDC ACM UART instance under the USB controller (zephyr_udc0),
 * for the firmware to use as a serial device -- this is the channel the host will
 * later use to read capture data.
 */

&zephyr_udc0 {
	cdc_acm_uart0: cdc_acm_uart0 {
		compatible = "zephyr,cdc-acm-uart";
	};
};
```

## src/adv_filter.h
```c
/* SPDX-License-Identifier: Apache-2.0 */
/*
 * Advertising PDU target filter -- pure function, no hardware dependency, called from
 * main's packet-RX interrupt and unit-tested on the host.
 *
 * Single-target mode: once a target MAC is set, of the PDUs received on the advertising
 * AA only those "related to the target" are forwarded to the host --
 *   - Sent by the target itself: ADV_IND / ADV_DIRECT_IND / ADV_NONCONN_IND / ADV_SCAN_IND / SCAN_RSP
 *     (AdvA at payload offset 0);
 *   - Sent to the target by others: SCAN_REQ / CONNECT_IND (ScanA/InitA first, AdvA at offset 6) --
 *     kept so you can see who is scanning it and who is connecting to it;
 *   - Extended advertising (ADV_EXT_IND / AUX_* share type 0x07, AUX_CONNECT_RSP 0x08): counts only
 *     when the extended header carries AdvA and it matches. The primary-channel ADV_EXT_IND often
 *     carries no AdvA; this version treats it as "unrelated".
 * CRC-bad packets are matched against AdvA by the same rules: kept if they match, which gives the
 * "include packets with CRC errors" option meaning.
 *
 * Reference: BT Core Spec Vol 6, Part B, §2.3 (advertising PDU format), §2.3.4 (extended header).
 */

#ifndef ADV_FILTER_H_
#define ADV_FILTER_H_

#include <stdbool.h>
#include <stdint.h>
#include <string.h>

#define ADV_FILTER_PDU_ADV_IND         0x00
#define ADV_FILTER_PDU_ADV_DIRECT_IND  0x01
#define ADV_FILTER_PDU_ADV_NONCONN_IND 0x02
#define ADV_FILTER_PDU_SCAN_REQ        0x03
#define ADV_FILTER_PDU_SCAN_RSP        0x04
#define ADV_FILTER_PDU_CONNECT_IND     0x05
#define ADV_FILTER_PDU_ADV_SCAN_IND    0x06
#define ADV_FILTER_PDU_ADV_EXT_IND     0x07
#define ADV_FILTER_PDU_AUX_CONNECT_RSP 0x08

#define ADV_FILTER_EXT_FLAG_ADVA       0x01

/**
 * Extract the AdvA ("who this packet is about") from an LL PDU (including the 2-byte header) received on the advertising AA.
 * @param pdu     Complete LL PDU: header(1) + length(1) + payload
 * @param pdu_len Total PDU length
 * @return pointer to the 6-byte AdvA inside the PDU (over-the-air little-endian); NULL if the type is unknown, carries no AdvA, or is too short
 */
static inline const uint8_t *adv_pdu_adva(const uint8_t *pdu, uint16_t pdu_len)
{
	if (pdu == NULL || pdu_len < 2) {
		return NULL;
	}

	const uint8_t type = pdu[0] & 0x0F;

	switch (type) {
	case ADV_FILTER_PDU_ADV_IND:
	case ADV_FILTER_PDU_ADV_DIRECT_IND:
	case ADV_FILTER_PDU_ADV_NONCONN_IND:
	case ADV_FILTER_PDU_SCAN_RSP:
	case ADV_FILTER_PDU_ADV_SCAN_IND:
		return (pdu_len >= 2 + 6) ? &pdu[2] : NULL;
	case ADV_FILTER_PDU_SCAN_REQ:
	case ADV_FILTER_PDU_CONNECT_IND:
		return (pdu_len >= 2 + 12) ? &pdu[2 + 6] : NULL;
	case ADV_FILTER_PDU_ADV_EXT_IND:
	case ADV_FILTER_PDU_AUX_CONNECT_RSP:
		/* pdu[2] = ExtHdrLen (low 6 bits) | AdvMode (high 2 bits); pdu[3] = extended header Flags;
		 * AdvA is the first optional field after Flags (bit0). */
		if (pdu_len >= 2 + 1 + 1 + 6) {
			const uint8_t ext_len = pdu[2] & 0x3F;
			const uint8_t flags = pdu[3];

			if (ext_len >= 1 + 6 && (flags & ADV_FILTER_EXT_FLAG_ADVA) != 0) {
				return &pdu[4];
			}
		}
		return NULL;
	default:
		return NULL;
	}
}

/**
 * Whether an LL PDU (including the 2-byte header) received on the advertising AA is related to the target AdvA.
 * @param target  6-byte BLE address, little-endian (matching the over-the-air order)
 */
static inline bool adv_pdu_matches_target(const uint8_t *pdu, uint16_t pdu_len,
					  const uint8_t target[6])
{
	const uint8_t *adva = adv_pdu_adva(pdu, pdu_len);

	return adva != NULL && memcmp(adva, target, 6) == 0;
}

/**
 * Parse "AA:BB:CC:DD:EE:FF" (also accepts '-' separators, any case) into a 6-byte
 * **over-the-air little-endian** address (display order is most-significant-first, the
 * over-the-air order is reversed, matching HOST_CMD_SET_TARGET / adv_pdu_matches_target).
 * @return true if the format is valid
 */
static inline bool adv_filter_parse_mac(const char *text, uint8_t out[6])
{
	if (text == NULL) {
		return false;
	}
	uint8_t disp[6];
	int n = 0;

	while (*text != '\0' && n < 6) {
		uint8_t v = 0;

		for (int k = 0; k < 2; k++) {
			const char c = *text++;
			uint8_t d;

			if (c >= '0' && c <= '9') {
				d = (uint8_t)(c - '0');
			} else if (c >= 'a' && c <= 'f') {
				d = (uint8_t)(c - 'a' + 10);
			} else if (c >= 'A' && c <= 'F') {
				d = (uint8_t)(c - 'A' + 10);
			} else {
				return false;
			}
			v = (uint8_t)((v << 4) | d);
		}
		disp[n++] = v;
		if (*text == ':' || *text == '-') {
			text++;
		}
	}
	if (n != 6 || *text != '\0') {
		return false;
	}
	for (int i = 0; i < 6; i++) {
		out[i] = disp[5 - i];
	}
	return true;
}

#endif /* ADV_FILTER_H_ */
```

## src/ble_csa.h
```c
/* SPDX-License-Identifier: Apache-2.0 */
/*
 * BLE Channel Selection Algorithm #1 / #2
 *
 * The core of connection following: the central and peripheral use the same algorithm on every
 * connection event to compute the data channel for the next hop. Only if the sniffer computes this
 * algorithm **exactly identically** to them can it hop along and capture packets.
 *
 * The algorithm itself is pure computation (no side effects, no hardware dependency), so it can be
 * unit-tested for equivalence against the official implementation on the host.
 *
 * Reference: Bluetooth Core Spec v5.2, Vol 6, Part B, §4.5.8.
 */

#ifndef BLE_CSA_H_
#define BLE_CSA_H_

#include <stdint.h>

/** Total number of data channels (0..36) */
#define BLE_DATA_CHANNELS 37

/**
 * Compute the channel identifier from the access address (used by CSA#2).
 * = AA high 16 bits XOR low 16 bits.
 */
uint16_t ble_csa_channel_id(uint32_t access_addr);

/**
 * CSA#1: compute the data channel for a given connection event.
 *
 * @param last_unmapped  the previous unmapped channel (initial value 0); this function updates it
 * @param hop            hop increment (from CONNECT_IND, 5..16)
 * @param latency        peripheral latency (number of skipped events, usually 0)
 * @param chan_map       37-bit channel map, 5 bytes little-endian (bit i = data channel i available)
 * @param chan_count     number of available channels in chan_map
 * @return the data channel to use for this event, 0..36
 */
uint8_t ble_csa1_next(uint8_t *last_unmapped, uint8_t hop, uint16_t latency,
		      const uint8_t *chan_map, uint8_t chan_count);

/**
 * CSA#2: compute the data channel for a given connection event.
 *
 * @param counter     the connection event counter for this event
 * @param chan_id     the result of ble_csa_channel_id()
 * @param chan_map    37-bit channel map, 5 bytes little-endian
 * @param chan_count  number of available channels
 * @return data channel 0..36
 */
uint8_t ble_csa2_next(uint16_t counter, uint16_t chan_id,
		      const uint8_t *chan_map, uint8_t chan_count);

/**
 * CSA#2 (ISO variant): compute the channel of the **first subevent** in a BIG / CIG event.
 *
 * The channel is the same as the one computed by ble_csa2_next(), but it additionally emits two
 * recursion states, used by ble_csa2_iso_subevent() to continue advancing through the subsequent
 * subevents within the same event.
 *
 * @param counter     BIG event counter (= bisPayloadCount / BN) or CIS event counter
 * @param chan_id     ble_csa_channel_id(the BIS/CIS's own access address)
 * @param chan_map    37-bit channel map, 5 bytes little-endian
 * @param chan_count  number of available channels
 * @param prn_lu      [out] subevent pseudo-random number recursion state
 * @param remap_idx   [out] remap index recursion state
 * @return data channel 0..36
 */
uint8_t ble_csa2_iso_event(uint16_t counter, uint16_t chan_id,
			   const uint8_t *chan_map, uint8_t chan_count,
			   uint16_t *prn_lu, uint16_t *remap_idx);

/**
 * CSA#2 (ISO variant): compute the channel of the **next subevent** within the same event.
 *
 * ble_csa2_iso_event() must have been called for this event first, then this function is called in
 * subevent order; prn_lu / remap_idx are advanced jointly by both and must not skip an index.
 *
 * @param chan_id     as above
 * @param chan_map    37-bit channel map, 5 bytes little-endian
 * @param chan_count  number of available channels
 * @param prn_lu      [in,out] recursion state
 * @param remap_idx   [in,out] recursion state
 * @return data channel 0..36
 */
uint8_t ble_csa2_iso_subevent(uint16_t chan_id, const uint8_t *chan_map,
			      uint8_t chan_count, uint16_t *prn_lu,
			      uint16_t *remap_idx);

/** Count the number of available channels in the 37-bit channel map */
uint8_t ble_csa_channel_count(const uint8_t *chan_map);

#endif /* BLE_CSA_H_ */
```

## src/ble_ctrl_pdu.c
```c
/* SPDX-License-Identifier: Apache-2.0 */
/*
 * Pure parsing implementation of the LL control PDUs added in BLE 6.x. See ble_ctrl_pdu.h.
 *
 * Reference: Bluetooth Core Specification v6.3, Vol 6, Part B, §2.4.2.
 */

#include "ble_ctrl_pdu.h"

#define UNIT_125_US   125u

/* ECV (Extended ConnInterval Values) valid range: 375µs..4s (Core 6.3 §4.5.1) */
#define CONN_INTERVAL_MIN_US   375u
#define CONN_INTERVAL_MAX_US   4000000u

/* Frame space upper limit 10ms (Core 6.3 §2.4.2.54) */
#define FRAME_SPACE_MAX_US     10000u

static uint16_t rd16(const uint8_t *p)
{
	return (uint16_t)p[0] | ((uint16_t)p[1] << 8);
}

bool ble_parse_conn_rate_ind(const uint8_t *ctrl, uint8_t len,
			     struct ble_conn_rate_ind *out)
{
	/* CtrData 14 bytes → Length (including the 1-byte opcode) ≥ 15. Field order per Figure 2.78:
	 * WinOffset(2) Interval(2) Instant(2) SubrateFactor(2) Latency(2)
	 * ContinuationNumber(2) Timeout(2), all little-endian. */
	if (len < 15u) {
		return false;
	}

	const uint32_t interval_us = (uint32_t)rd16(&ctrl[3]) * UNIT_125_US;

	/* On an unencrypted connection, random bytes with llid=3 may happen to hit 0x3F; use the ECV range to reject false positives */
	if (interval_us < CONN_INTERVAL_MIN_US || interval_us > CONN_INTERVAL_MAX_US) {
		return false;
	}

	out->win_offset_us = (uint32_t)rd16(&ctrl[1]) * UNIT_125_US;
	out->interval_us = interval_us;
	out->instant = rd16(&ctrl[5]);
	out->subrate_factor = rd16(&ctrl[7]);
	out->latency = rd16(&ctrl[9]);
	out->continuation_number = rd16(&ctrl[11]);
	out->timeout_10ms = rd16(&ctrl[13]);
	return true;
}

/* Connection interval (in 1.25ms units) valid range: 6..3200 = 7.5ms..4s (Core §4.5.1) */
#define CONN_INTERVAL_MIN_UNITS 6u
#define CONN_INTERVAL_MAX_UNITS 3200u
#define UNIT_1250_US            1250u

bool ble_parse_conn_update_ind(const uint8_t *ctrl, uint8_t len,
			       struct ble_conn_update_ind *out)
{
	/* CtrData 11 bytes → Length ≥ 12. Field order (§2.4.2.1, all little-endian):
	 * WinSize(1) WinOffset(2) Interval(2) Latency(2) Timeout(2) Instant(2). */
	if (len < 12u) {
		return false;
	}

	/* ctrl[0] is the opcode; CtrData starts at ctrl[1]: WinSize takes 1 byte, followed by the 2-byte fields */
	const uint16_t win_offset = rd16(&ctrl[2]);
	const uint16_t interval = rd16(&ctrl[4]);

	if (interval < CONN_INTERVAL_MIN_UNITS || interval > CONN_INTERVAL_MAX_UNITS ||
	    win_offset > interval) {
		return false;
	}

	out->win_size = ctrl[1];
	out->win_offset = win_offset;
	out->interval = interval;
	out->latency = rd16(&ctrl[6]);
	out->timeout_10ms = rd16(&ctrl[8]);
	out->instant = rd16(&ctrl[10]);
	return true;
}

uint32_t ble_conn_update_new_anchor_us(uint32_t old_anchor_us,
				       const struct ble_conn_update_ind *u)
{
	return old_anchor_us + (uint32_t)u->win_offset * UNIT_1250_US;
}

bool ble_parse_frame_space_rsp(const uint8_t *ctrl, uint8_t len,
			       struct ble_frame_space_rsp *out)
{
	/* CtrData: FS(2) PHYS(1) Spacing_Types(1) → Length ≥ 5 (Figure 2.75) */
	if (len < 5u) {
		return false;
	}

	const uint16_t fs = rd16(&ctrl[1]);

	if (fs == 0u || fs > FRAME_SPACE_MAX_US) {
		return false;
	}

	out->fs_us = fs;
	out->phys = ctrl[3];
	out->spacing_types = ctrl[4];
	return true;
}

const char *ble_ll_ctrl_name(uint8_t opcode)
{
	switch (opcode) {
	case BLE_LL_FEATURE_EXT_REQ:     return "LL_FEATURE_EXT_REQ";
	case BLE_LL_FEATURE_EXT_RSP:     return "LL_FEATURE_EXT_RSP";
	case BLE_LL_CS_SEC_RSP:          return "LL_CS_SEC_RSP";
	case BLE_LL_CS_CAPABILITIES_REQ: return "LL_CS_CAPABILITIES_REQ";
	case BLE_LL_CS_CAPABILITIES_RSP: return "LL_CS_CAPABILITIES_RSP";
	case BLE_LL_CS_CONFIG_REQ:       return "LL_CS_CONFIG_REQ";
	case BLE_LL_CS_CONFIG_RSP:       return "LL_CS_CONFIG_RSP";
	case BLE_LL_CS_REQ:              return "LL_CS_REQ";
	case BLE_LL_CS_RSP:              return "LL_CS_RSP";
	case BLE_LL_CS_IND:              return "LL_CS_IND";
	case BLE_LL_CS_TERMINATE_REQ:    return "LL_CS_TERMINATE_REQ";
	case BLE_LL_CS_FAE_REQ:          return "LL_CS_FAE_REQ";
	case BLE_LL_CS_FAE_RSP:          return "LL_CS_FAE_RSP";
	case BLE_LL_CS_CHANNEL_MAP_IND:  return "LL_CS_CHANNEL_MAP_IND";
	case BLE_LL_CS_SEC_REQ:          return "LL_CS_SEC_REQ";
	case BLE_LL_CS_TERMINATE_RSP:    return "LL_CS_TERMINATE_RSP";
	case BLE_LL_FRAME_SPACE_REQ:     return "LL_FRAME_SPACE_REQ";
	case BLE_LL_FRAME_SPACE_RSP:     return "LL_FRAME_SPACE_RSP";
	case BLE_LL_OTA_UTP_IND:         return "LL_OTA_UTP_IND";
	case BLE_LL_CONNECTION_RATE_REQ: return "LL_CONNECTION_RATE_REQ";
	case BLE_LL_CONNECTION_RATE_IND: return "LL_CONNECTION_RATE_IND";
	default:                         return (const char *)0;
	}
}
```

## src/ble_ctrl_pdu.h
```c
/* SPDX-License-Identifier: Apache-2.0 */
/*
 * Pure parsing of the LL control PDUs added in BLE 6.x (no hardware dependency)
 *
 * Splits "parsing CtrData per the Core Spec byte layout" out of conn_follower's hardware/scheduling
 * logic -- pure functions, no side effects, can be rigorously self-tested on a PC with byte vectors
 * built from the spec on the host. If the byte offset of these PDUs is off by
 * even one, following silently loses the connection, so like CSA they must be thoroughly tested
 * before running on the board.
 *
 * Reference: Bluetooth Core Specification v6.3, Vol 6, Part B, §2.4.2 and Table 2.22.
 *
 * Also covers the parsing of an older PDU where "one wrong offset loses the connection":
 * LL_CONNECTION_UPDATE_IND (§2.4.2.1).
 */

#ifndef BLE_CTRL_PDU_H_
#define BLE_CTRL_PDU_H_

#include <stdbool.h>
#include <stdint.h>

/* ---- LL control PDU opcodes added in 6.x (Core v6.3 Vol6 PartB Table 2.22) ---- */
#define BLE_LL_FEATURE_EXT_REQ       0x2B  /* Extended feature set (6.0) */
#define BLE_LL_FEATURE_EXT_RSP       0x2C
#define BLE_LL_CS_SEC_RSP            0x2D  /* Channel Sounding negotiation family (6.0), 0x2D..0x3A */
#define BLE_LL_CS_CAPABILITIES_REQ   0x2E
#define BLE_LL_CS_CAPABILITIES_RSP   0x2F
#define BLE_LL_CS_CONFIG_REQ         0x30
#define BLE_LL_CS_CONFIG_RSP         0x31
#define BLE_LL_CS_REQ                0x32
#define BLE_LL_CS_RSP                0x33
#define BLE_LL_CS_IND                0x34
#define BLE_LL_CS_TERMINATE_REQ      0x35
#define BLE_LL_CS_FAE_REQ            0x36
#define BLE_LL_CS_FAE_RSP            0x37
#define BLE_LL_CS_CHANNEL_MAP_IND    0x38
#define BLE_LL_CS_SEC_REQ            0x39
#define BLE_LL_CS_TERMINATE_RSP      0x3A
#define BLE_LL_FRAME_SPACE_REQ       0x3B  /* Frame space negotiation (6.0) */
#define BLE_LL_FRAME_SPACE_RSP       0x3C
#define BLE_LL_OTA_UTP_IND           0x3D  /* LE test mode OTA (6.2) */
#define BLE_LL_CONNECTION_RATE_REQ   0x3E  /* Short connection interval (6.2) */
#define BLE_LL_CONNECTION_RATE_IND   0x3F

/** Contiguous opcode range of the CS negotiation PDUs */
#define BLE_LL_CS_OPCODE_MIN         BLE_LL_CS_SEC_RSP        /* 0x2D */
#define BLE_LL_CS_OPCODE_MAX         BLE_LL_CS_TERMINATE_RSP  /* 0x3A */

/** Whether the opcode belongs to the Channel Sounding negotiation family (6.0) */
static inline bool ble_ll_ctrl_is_cs(uint8_t opcode)
{
	return opcode >= BLE_LL_CS_OPCODE_MIN && opcode <= BLE_LL_CS_OPCODE_MAX;
}

/**
 * Parsed result of LL_CONNECTION_RATE_IND (0x3F, 6.2 short connection interval).
 * The interval is in units of **125µs** (not the older 1.25ms); it has already been converted to µs here.
 */
struct ble_conn_rate_ind {
	uint32_t win_offset_us;      /* WinOffset × 125µs */
	uint32_t interval_us;        /* Interval × 125µs; ECV range 375µs..4s */
	uint16_t instant;            /* connection event at which it takes effect */
	uint16_t subrate_factor;     /* connSubrateFactor */
	uint16_t latency;            /* connPeripheralLatency */
	uint16_t continuation_number;/* connContinuationNumber */
	uint16_t timeout_10ms;       /* connSupervisionTimeout ÷ 10ms */
};

/**
 * Parse the CtrData of LL_CONNECTION_RATE_IND (excluding the opcode).
 *
 * @param ctrl  points at the opcode byte (ctrl[0]==0x3F), followed by 14 bytes of CtrData
 * @param len   the Length field of the LL control PDU (= 1 + CtrData length)
 * @param out   parsed result (valid only when true is returned)
 * @return true if the length is sufficient and the interval falls within the valid ECV range (375µs..4s); otherwise false
 */
bool ble_parse_conn_rate_ind(const uint8_t *ctrl, uint8_t len,
			     struct ble_conn_rate_ind *out);

/**
 * Parsed result of LL_CONNECTION_UPDATE_IND (0x00, Core Vol 6 Part B §2.4.2.1).
 * The time fields are all in 1.25ms units (same as CONNECT_IND); kept as-is here, to be converted by the caller.
 */
struct ble_conn_update_ind {
	uint8_t win_size;        /* transmitWindowSize, ×1.25ms */
	uint16_t win_offset;     /* transmitWindowOffset, ×1.25ms; 0 ≤ WinOffset ≤ Interval */
	uint16_t interval;       /* connInterval, ×1.25ms; 6..3200 */
	uint16_t latency;        /* connPeripheralLatency */
	uint16_t timeout_10ms;   /* connSupervisionTimeout ÷ 10ms */
	uint16_t instant;        /* connection event at which it takes effect */
};

/**
 * Parse the CtrData of LL_CONNECTION_UPDATE_IND (excluding the opcode).
 *
 * @param ctrl  points at the opcode byte (ctrl[0]==0x00), followed by 11 bytes of CtrData
 * @param len   the Length field of the LL control PDU (= 1 + CtrData length)
 * @param out   parsed result (valid only when true is returned)
 * @return true if the length is sufficient, Interval is within 7.5ms..4s, and WinOffset ≤ Interval; otherwise false
 */
bool ble_parse_conn_update_ind(const uint8_t *ctrl, uint8_t len,
			       struct ble_conn_update_ind *out);

/**
 * The new anchor point of the event at which the update takes effect (instant) (Core Vol 6 Part B §5.1.1):
 * the central's first packet lands within a window starting at "old anchor + transmitWindowOffset" and
 * transmitWindowSize wide.
 * This step was not done before: when WinOffset is large (32 × 1.25ms = 40ms on a real device), the follower
 * opens its window at the old anchor and inevitably loses the connection.
 *
 * @param old_anchor_us  the anchor point extrapolated to the instant event by the old interval (µs, 32-bit wraparound)
 * @return the new anchor point (window start), µs, 32-bit wraparound
 */
uint32_t ble_conn_update_new_anchor_us(uint32_t old_anchor_us,
				       const struct ble_conn_update_ind *u);

/** Parsed result of LL_FRAME_SPACE_RSP (0x3C, 6.0 frame space negotiation) */
struct ble_frame_space_rsp {
	uint16_t fs_us;         /* the selected frame space, µs (≤10ms) */
	uint8_t phys;           /* applicable PHY bitmap */
	uint8_t spacing_types;  /* applicable spacing-type bitmap: bit0=T_IFS_ACL_CP bit1=T_IFS_ACL_PC… */
};

/** Two-bit mask for the ACL-direction T_IFS in spacing_types */
#define BLE_FS_SPACING_ACL_MASK  0x03u

/**
 * Parse the CtrData of LL_FRAME_SPACE_RSP.
 *
 * @return true if the length is sufficient and the frame space is within the valid range (0<fs≤10ms); otherwise false
 */
bool ble_parse_frame_space_rsp(const uint8_t *ctrl, uint8_t len,
			       struct ble_frame_space_rsp *out);

/** opcode → human-readable name (returns NULL if unknown). For logs / capture summaries. */
const char *ble_ll_ctrl_name(uint8_t opcode);

#endif /* BLE_CTRL_PDU_H_ */
```

## src/board_role.c
```c
/* SPDX-License-Identifier: Apache-2.0 */
/*
 * Board role identification implementation — see board_role.h.
 */

#include <zephyr/kernel.h>
#include <zephyr/drivers/gpio.h>
#include <zephyr/logging/log.h>

#include "board_role.h"
#include "radio_hal.h"   /* BLE_CHANNEL_ADV_37/38/39 */

LOG_MODULE_REGISTER(board_role, LOG_LEVEL_INF);

/* Power-up settling: after the internal pull-up (~13k) is enabled the pin's parasitic capacitance needs µs to charge to a high level; reading right after configuring may
 * misread a floating pin as 0, and a fly-wire strap may bounce. So wait a short moment first, then require two consecutive identical reads before trusting the value. */
#define STRAP_SETTLE_US   100
#define STRAP_READ_RETRY  5

/* The two straps are provided by DT aliases tri-strap0 / tri-strap1 (see the board overlay).
 * The DK has no such alias group — check with DT_NODE_EXISTS and take the fallback path if absent. */
#define STRAP0_NODE DT_ALIAS(tri_strap0)
#define STRAP1_NODE DT_ALIAS(tri_strap1)

#if DT_NODE_EXISTS(STRAP0_NODE) && DT_NODE_EXISTS(STRAP1_NODE)
#define TRI_STRAPS_PRESENT 1
static const struct gpio_dt_spec strap0 = GPIO_DT_SPEC_GET(STRAP0_NODE, gpios);
static const struct gpio_dt_spec strap1 = GPIO_DT_SPEC_GET(STRAP1_NODE, gpios);
#else
#define TRI_STRAPS_PRESENT 0
#endif

#if TRI_STRAPS_PRESENT
/* strap encoding (S1,S0) → role. ch uses the advertising-channel index. */
static struct board_role role_from_code(uint8_t code)
{
	switch (code) {
	case 0x0:  /* 00 = node A */
		return (struct board_role){ .board_id = 0, .guard_channel = BLE_CHANNEL_ADV_37 };
	case 0x2:  /* 10 = node B */
		return (struct board_role){ .board_id = 1, .guard_channel = BLE_CHANNEL_ADV_38 };
	case 0x1:  /* 01 = node C */
		return (struct board_role){ .board_id = 2, .guard_channel = BLE_CHANNEL_ADV_39 };
	default:   /* 11 reserved */
		LOG_WRN("strap combination 0b%u%u reserved, falling back to {id=0, ch=37}",
			(code >> 1) & 1, code & 1);
		return (struct board_role){ .board_id = 0, .guard_channel = BLE_CHANNEL_ADV_37 };
	}
}
#endif /* TRI_STRAPS_PRESENT */

struct board_role board_role_read(void)
{
#if TRI_STRAPS_PRESENT
	if (!gpio_is_ready_dt(&strap0) || !gpio_is_ready_dt(&strap1)) {
		LOG_WRN("strap GPIO not ready, falling back to {id=0, ch=37}");
		return (struct board_role){ .board_id = 0, .guard_channel = BLE_CHANNEL_ADV_37 };
	}

	/* Input + pull-up: a strap tied to GND reads 0, floating/pulled-up reads 1. Use ACTIVE_HIGH semantics
	 * so that gpio_pin_get_dt returns the level directly (high=1 low=0). */
	(void)gpio_pin_configure_dt(&strap0, GPIO_INPUT | GPIO_PULL_UP | GPIO_ACTIVE_HIGH);
	(void)gpio_pin_configure_dt(&strap1, GPIO_INPUT | GPIO_PULL_UP | GPIO_ACTIVE_HIGH);

	k_busy_wait(STRAP_SETTLE_US);
	int s0 = gpio_pin_get_dt(&strap0);
	int s1 = gpio_pin_get_dt(&strap1);

	for (int i = 0; i < STRAP_READ_RETRY; i++) {
		k_busy_wait(STRAP_SETTLE_US);
		const int r0 = gpio_pin_get_dt(&strap0);
		const int r1 = gpio_pin_get_dt(&strap1);

		if (r0 == s0 && r1 == s1) {
			break;   /* two consecutive reads agree, trust it */
		}
		s0 = r0;
		s1 = r1;
	}

	if (s0 < 0 || s1 < 0) {
		LOG_WRN("strap read failed (s0=%d s1=%d), falling back to {id=0, ch=37}", s0, s1);
		return (struct board_role){ .board_id = 0, .guard_channel = BLE_CHANNEL_ADV_37 };
	}

	const uint8_t code = (uint8_t)(((s1 & 1) << 1) | (s0 & 1));
	const struct board_role r = role_from_code(code);

	LOG_INF("role: board_id=%u guard_channel=%u (strap S1S0=%u%u)",
		r.board_id, r.guard_channel, (code >> 1) & 1, code & 1);
	return r;
#else
	/* No strap alias (e.g. single-board DK): run with single-board defaults — board_id 0, channel 37. */
	LOG_INF("no strap alias defined, using single-board default {id=0, ch=37}");
	return (struct board_role){ .board_id = 0, .guard_channel = BLE_CHANNEL_ADV_37 };
#endif
}
```

## src/board_role.h
```c
/* SPDX-License-Identifier: Apache-2.0 */
/*
 * Board role identification — all three boards run identical firmware and read 2 strap GPIOs at boot to self-identify their role.
 *
 * On each of the three custom boards one strap group is hard-wired (design §4.5: 2 GPIOs coded via tie-to-GND / pull-up),
 * deciding whether this board is A/B/C and which of the 37/38/39 advertising channels it guards. The firmware binary is identical across all three boards;
 * the role is determined purely at runtime by the straps — no separate firmware build per board.
 *
 * strap encoding (S1,S0):
 *   00 → board_id 0, guards channel 37 (node A)
 *   10 → board_id 1, guards channel 38 (node B)
 *   01 → board_id 2, guards channel 39 (node C)
 *   11 → reserved, falls back to {0, 37} and warns
 *
 * A strap tied to GND reads as 0; floating with the internal pull-up it reads as 1. On the DK (which lacks this strap group) the DT alias does not exist,
 * so board_role_read() falls back to {0, 37}, keeping the single-board firmware running as usual.
 */

#ifndef BOARD_ROLE_H_
#define BOARD_ROLE_H_

#include <stdint.h>

struct board_role {
	uint8_t board_id;        /**< This board's id 0/1/2 */
	uint8_t guard_channel;   /**< The advertising channel this board guards 37/38/39 */
};

/**
 * Read the straps to decide the role. Falls back to {0, 37} with LOG_WRN when the DT strap alias is undefined or the read fails.
 * Idempotent, may be called multiple times; internally configures the strap pins as input + pull-up.
 */
struct board_role board_role_read(void);

#endif /* BOARD_ROLE_H_ */
```

## src/cobs.c
```c
/* SPDX-License-Identifier: Apache-2.0 */
/* COBS encode/decode -- see the notes in cobs.h for the implementation */

#include "cobs.h"

size_t cobs_encode(const uint8_t *in, size_t in_len, uint8_t *out)
{
	size_t read_i = 0;
	size_t write_i = 1;   /* out[0] reserved as a placeholder for the first code */
	size_t code_i = 0;
	uint8_t code = 1;

	while (read_i < in_len) {
		if (in[read_i] == 0) {
			/* Hit a zero byte: write the current run length back into the code slot, start a new run */
			out[code_i] = code;
			code = 1;
			code_i = write_i++;
			read_i++;
			continue;
		}

		out[write_i++] = in[read_i++];
		code++;

		/* A run is at most 254 bytes long; force a break when it is full */
		if (code == 0xFF) {
			out[code_i] = code;
			code = 1;
			code_i = write_i++;
		}
	}

	out[code_i] = code;

	return write_i;
}

size_t cobs_decode(const uint8_t *in, size_t in_len, uint8_t *out, size_t out_sz)
{
	size_t read_i = 0;
	size_t write_i = 0;

	while (read_i < in_len) {
		const uint8_t code = in[read_i];

		if (code == 0) {
			return 0;   /* 0 should never appear in the encoded stream */
		}

		read_i++;

		/* Copy out code-1 non-zero bytes verbatim */
		for (uint8_t i = 1; i < code; i++) {
			if (read_i >= in_len || write_i >= out_sz) {
				return 0;   /* data was truncated, or the output buffer is too small */
			}
			out[write_i++] = in[read_i++];
		}

		/* If the run is not full at 254 and more data follows, the original had a zero byte here */
		if (code != 0xFF && read_i < in_len) {
			if (write_i >= out_sz) {
				return 0;
			}
			out[write_i++] = 0;
		}
	}

	return write_i;
}
```

## src/cobs.h
```c
/* SPDX-License-Identifier: Apache-2.0 */
/*
 * COBS (Consistent Overhead Byte Stuffing) encode/decode
 *
 * Purpose: encode arbitrary binary data into a "byte stream containing no 0x00", so that a single
 * 0x00 can serve as the frame delimiter. When the serial link drops bytes or the host attaches
 * mid-stream, it can re-align simply by waiting for the next 0x00 -- no complex sync word or length
 * check needed.
 *
 * The overhead is fixed and tiny: at most 1 extra byte per 254 bytes.
 *
 * Reference: Cheshire & Baker, "Consistent Overhead Byte Stuffing", 1999.
 */

#ifndef COBS_H_
#define COBS_H_

#include <stddef.h>
#include <stdint.h>

/** Worst-case output buffer size needed to encode len bytes (excluding the trailing delimiter) */
#define COBS_ENCODED_MAX(len)   ((len) + ((len) / 254) + 1)

/**
 * COBS encode. The output does not include the trailing 0x00 delimiter; the caller appends it.
 *
 * @param in      data to encode
 * @param in_len  length
 * @param out     output buffer, at least COBS_ENCODED_MAX(in_len) bytes
 * @return the number of bytes written to out
 */
size_t cobs_encode(const uint8_t *in, size_t in_len, uint8_t *out);

/**
 * COBS decode. The input should be the content between two 0x00 delimiters (excluding the delimiters themselves).
 *
 * @param in      encoded data
 * @param in_len  length
 * @param out     output buffer, at least in_len bytes
 * @param out_sz  output buffer size
 * @return the number of bytes decoded; returns 0 if the input is invalid or the buffer is too small
 */
size_t cobs_decode(const uint8_t *in, size_t in_len, uint8_t *out, size_t out_sz);

#endif /* COBS_H_ */
```

## src/dir_policy.h
```c
/* SPDX-License-Identifier: Apache-2.0 */
/*
 * Direction of a data-channel packet within a connection event -- a pure function with no
 * hardware dependency, called by conn_follower and unit-tested on the host (test/host/test_dir_policy.c).
 *
 * Within a connection event the central and peripheral transmit strictly alternately, with one
 * T_IFS (150µs by default, negotiable in 6.0) between adjacent packets. So: the first packet of an
 * event = central -> peripheral; after that, every packet that follows one T_IFS later flips the
 * direction.
 *
 * The old rule was "everything after the first packet is peripheral -> central". When the central
 * sends two PDUs in one event (with DLE 251, a 498-byte ATT Write splits into 251+251, so every
 * event during OTA is C,P,C,P -- four packets) the second one was mislabelled, and the host
 * reassembled the ATT in the wrong direction, so half of the write commands could not be rebuilt.
 *
 * Dropped packets: when the air gap between two packets is clearly larger than one T_IFS, at least
 * one packet was missed in between. If the gap fits one shortest PDU (an empty packet) but not two,
 * exactly one was missed, so the direction is the same as the previous packet; a larger gap cannot
 * tell how many were missed, so it returns unknown, and later packets in the event derived from an
 * unknown stay unknown.
 */
#ifndef DIR_POLICY_H_
#define DIR_POLICY_H_

#include <stdint.h>

/** Direction values, matching HOST_DIR_* in host_iface.h */
#define DIR_UNKNOWN 0u
#define DIR_C2P     1u
#define DIR_P2C     2u

struct dir_tracker {
	uint8_t pkts;           /**< packets received in this event (saturating) */
	uint8_t last;           /**< previous packet's direction, DIR_* */
	uint32_t last_end_us;   /**< previous packet's air end (CRC tail) timestamp */
};

static inline void dir_tracker_reset(struct dir_tracker *t)
{
	t->pkts = 0;
	t->last = DIR_UNKNOWN;
	t->last_end_us = 0;
}

static inline uint8_t dir_flip(uint8_t d)
{
	if (d == DIR_C2P) {
		return DIR_P2C;
	}
	if (d == DIR_P2C) {
		return DIR_C2P;
	}
	return DIR_UNKNOWN;
}

/**
 * Another packet arrived in this event: return its direction and record the state.
 *
 * @param start_us        this packet's preamble start timestamp
 * @param end_us          this packet's CRC end timestamp
 * @param t_ifs_us        the link's effective inter-frame space (150 by default; the negotiated
 *                        value after a 6.0 negotiation)
 * @param min_pdu_air_us  air time of the shortest PDU (an empty packet, preamble -> CRC) on the
 *                        current PHY
 * @return DIR_C2P / DIR_P2C / DIR_UNKNOWN
 */
static inline uint8_t dir_tracker_on_packet(struct dir_tracker *t, uint32_t start_us,
					    uint32_t end_us, uint16_t t_ifs_us,
					    uint32_t min_pdu_air_us)
{
	uint8_t d;

	if (t->pkts == 0) {
		d = DIR_C2P;   /* the first packet of an event can only be the central's */
	} else {
		const uint32_t gap = start_us - t->last_end_us;   /* unsigned-wraparound safe */

		if (gap < 2u * (uint32_t)t_ifs_us) {
			/* Right after one T_IFS: the reply. Under two T_IFS cannot fit a dropped packet
			 * (even a 2M empty packet takes 44µs), so this bucket needs no extra tolerance. */
			d = dir_flip(t->last);
		} else if (gap < 3u * (uint32_t)t_ifs_us + 2u * min_pdu_air_us) {
			d = t->last;   /* exactly one was missed: same direction */
		} else {
			d = DIR_UNKNOWN;   /* two or more missed, cannot tell */
		}
	}
	if (t->pkts < 255u) {
		t->pkts++;
	}
	t->last = d;
	t->last_end_us = end_us;
	return d;
}

#endif /* DIR_POLICY_H_ */
```

## src/fem_ctrl.h
```c
/* SPDX-License-Identifier: Apache-2.0 */
/*
 * nRF21540 FEM control -- pure GPIO mode (no SPI). One FEM per SoC (hardware README "nRF21540 FEM").
 *
 * Why GPIO only, no register writes:
 *   The nRF21540 works at factory defaults right after power-up: PA gain is selected by the MODE pin
 *   between the two factory presets POUTA (+20 dBm) / POUTB (+10 dBm), the PA/LNA switching is all
 *   done via TX_EN/RX_EN, and driving PDN high enters the PG (powered-up) state -- not a single
 *   register write needed. SPI is only an "optional override" (fine-tuning TX gain / reading the ID);
 *   the sniffer only receives and never transmits, so it is not needed.
 *
 * ⚠️ Hard rule (early nRF54LM20A samples):
 *   On some early nRF54LM20A samples, QFN52 pin 30 (P0.09) is tied to VDD inside the package and is
 *   not a GPIO, yet on the full board P0.09 happens to connect to the FEM's MISO. The FEM's MISO is
 *   only driven when CSN is low and is high-Z when CSN is high, so as long as **CSN always outputs
 *   high, SCK/MOSI are not used for SPI, and MISO (P0.09) is never configured**, such a sample is
 *   indistinguishable from the production part and there is no current path on the line. Whoever
 *   changes this must not pull CSN low or initialize anything on P0.09.
 *
 * State machine (throughout): PD --PDN=1--> PG --RX_EN=1--> RX (LNA always on). The sniffer receives
 * the whole time, and the LNA is not switched on/off with the radio's start/stop.
 * The PA goes through fem_ctrl_set_tx(): TX_EN/RX_EN switch mutually exclusively, waiting for the
 * nRF21540 PS Table 6 settling times.
 * The firmware currently does not transmit; this interface is reserved (injection / DTM).
 *
 * DT: the tri_fem node + fem-* aliases in the overlay. A missing alias is treated as no FEM (e.g. the
 * nRF52840 DK); init returns 0 but the feature is disabled -- the same convention as sync_line / peer_link.
 */

#ifndef FEM_CTRL_H_
#define FEM_CTRL_H_

#include <stdbool.h>

/**
 * Power up the FEM and keep the LNA always on: CSN high → each control pin to a defined state →
 * PDN high (wait PD→PG) → RX_EN high (wait PG→RX).
 * Must be called **before** the radio starts receiving: the nRF21540 has no bypass path, so the RF path is broken when PDN=0.
 * @return 0 on success or no FEM (disabled); a negative errno (GPIO not ready / configuration failed)
 */
int fem_ctrl_init(void);

/**
 * PA switch (GPIO controlled). on=true: RX_EN low → TX_EN high, wait for the PA to settle; on=false: return to LNA always on.
 * Blocks for the settling time (tens of µs); a no-op when there is no FEM.
 */
void fem_ctrl_set_tx(bool on);

#endif /* FEM_CTRL_H_ */
```
